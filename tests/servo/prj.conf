## CMakeLists.txt
```
cmake_minimum_required(VERSION 3.20.0)
find_package(Zephyr REQUIRED HINTS $ENV{ZEPHYR_BASE})
project(test_servo)

set(APP_ROOT ${CMAKE_CURRENT_LIST_DIR}/../..)

target_sources(app PRIVATE
    src/test_servo.cpp
    ${APP_ROOT}/lib/servo/src/servo.cpp
)

target_include_directories(app PRIVATE
    ${APP_ROOT}/lib/servo/include
)
```

## prj.conf
```kconfig
# Suporte a C++
CONFIG_CPP=y
CONFIG_STD_CPP20=y
CONFIG_REQUIRES_FULL_LIBCPP=y

# Dependências da classe Servo
CONFIG_PWM=y

# Requisitos de teste
CONFIG_ZTEST=y
```

## src/test_servo.cpp
```c
/*
 * Testes da classe Servo — apenas a conversão pura ângulo -> pulso PWM
 * (Servo::calcularPulso), que não depende de um dispositivo PWM real.
 */

#include <zephyr/ztest.h>
#include <servo.hpp>

#define PULSO_MIN 1000000U /* 1 ms -> 0°   */
#define PULSO_MAX 2000000U /* 2 ms -> 180° */

ZTEST(servo, test_extremos)
{
    zassert_equal(Servo::calcularPulso(0, PULSO_MIN, PULSO_MAX), PULSO_MIN);
    zassert_equal(Servo::calcularPulso(180, PULSO_MIN, PULSO_MAX), PULSO_MAX);
}

ZTEST(servo, test_meio_curso)
{
    zassert_equal(Servo::calcularPulso(90, PULSO_MIN, PULSO_MAX), 1500000U);
}

ZTEST(servo, test_satura_abaixo_de_zero)
{
    zassert_equal(Servo::calcularPulso(-10, PULSO_MIN, PULSO_MAX), PULSO_MIN);
}

ZTEST(servo, test_satura_acima_de_180)
{
    zassert_equal(Servo::calcularPulso(200, PULSO_MIN, PULSO_MAX), PULSO_MAX);
}

ZTEST_SUITE(servo, nullptr, nullptr, nullptr, nullptr, nullptr);
```
